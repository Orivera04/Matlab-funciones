;;
;; C166/ST10 startup code generated by EDE for project kc167crv80flash
;;
;; If modifications are needed, disable generation of the startup code in EDE:
;; In the EDE Project Options dialog select Application, and then Startup. Make
;; sure the checkbox 'Generate system startup code and add it to project' is not
;; checked. Note that changes in EDE will now no longer be reflected in the
;; startup code. Also be aware that the modifications will be overwritten when
;; the checkbox is enabled again.
;;

$EXTEND
$CASE
$GENONLY
$DEBUG
$NOLOCALS
$CHECKCPU16
$CHECKBUS18
$NOMOD166				; disable the internal set of SFRs
$STDNAMES(reg167cr.def)		; define SFRs

$INCLUDE(head.asm)			; Generic definitions (see product include dir)
$INCLUDE(_c_init.asm)			; Initialize C variables

	NAME	CSTART			; module name

	PUBLIC	__IDLE			; cstart end
	PUBLIC	__EXIT			; address to jump to on 'exit()'
	EXTERN	_main:FAR		; start label user program
	EXTERN __C_INIT:FAR

__CSTART_PR	SECTION CODE WORD PUBLIC 'CPROGRAM'
__CSTART	PROC TASK __CSTART_TASK INTNO __CSTART_INUM = 0

	BFLDL	SYSCON, #0xDF, #0x0085&0xFF
	BFLDH	SYSCON, #0xFF, #(0x0085>>8)&0xFF
	MOV	ADDRSEL1, #0x0404
	BFLDL	BUSCON0, #0xFF, #0x04af&0xFF
	BFLDH	BUSCON0, #0xD6, #(0x04af>>8)&0xFF
	BFLDL	BUSCON1, #0xFF, #0x04AF&0xFF
	BFLDH	BUSCON1, #0xD6, #(0x04AF>>8)&0xFF
	
	ATOMIC	#3
	MOV	SP,	#?SYSSTACK_TOP		; Set stack pointer.
	MOV	STKOV,	#?SYSSTACK_BOTTOM + 6*2	; Set stack overflow pointer.
	MOV	STKUN,	#?SYSSTACK_TOP		; Set stack underflow pointer.

	MOV	CP,	#CSTART_RBANK		; Set context pointer.
	NOP			

	MOV	DPP0, #PAG ?BASE_DPP0	; Set data page pointer.
	MOV	DPP1, #PAG ?BASE_DPP1	; Initialise these before we can make a
	MOV	DPP2, #PAG ?BASE_DPP2	; user stack call below
	MOV	R0, #?USRSTACK_TOP	; set user stack pointer

	DISWDT				;  Disable watchdog timer

	EINIT				; End of initialization

@SET( BIT_INIT, 0 )			; disable(0)/enable(1) initialization of bit
					; variables at startup
@_CALL(__C_INIT, R1)			; initalization of global/static data

	BSET	IEN			; allow monitor to break application

	MOV	R12, #0			; set argc to 0
	MOV	R13, #0			;
	MOV	R14, #0			; set argv[] to 0

@_CALL( _main, R1)

; The exit() function causes normal program termination to occur. First, all 
; functions registered by the atexit() function are called in the reverse 
; order. Next, all open streams with unwritten buffered data are flushed, all 
; open streams are closed and all files created by the tmpfile() function are 
; removed. The status value passed to exit is returned in R4.
__EXIT: LABEL FAR			; the exit() or abort() function jumps
					; to this entry.
__IDLE: IDLE				; Power down CPU until peripheral inter-
					; rupt or external interrupt occurs.
	JMPR	CC_UC, __IDLE		; set idle mode again.
	RETV				; Virtual return.
__CSTART	ENDP
__CSTART_PR	ENDS


C166_US	SECTION	LDAT WORD GLBUSRSTACK 'CUSTACK'
	DS	2			; Allocate a user stack of at least 2 bytes
C166_US	ENDS


CSTART_RBANK	REGDEF R0-R15		; Register usage
		SSKDEF	0	; System stack size

		END
