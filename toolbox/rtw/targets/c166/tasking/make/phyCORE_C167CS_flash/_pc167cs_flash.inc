; _pc167cs_flash.inc
;
; This macro preprocessor control file has been generated by TASKING EDE for the 'pc167cs_flash' project
;
DEF(_CPU,167cs)
DEF(_EXT,1)
DEF(_EXTMAC,0)
DEF(_EXT2,0)
DEF(_EXT22,0)
DEF(__STKSZ,0)

DEF(__STDNAMES,reg167cs.def)
DEF(__XPER_SHARE,0)
DEF(__VISIBLE,0)
DEF(__XPEN,1)
DEF(__BDRSTEN,0)
DEF(__OWDDIS,1)
DEF(__CSCFG,0)

DEF(__WRCFG,1)
DEF(__CLKEN,0)
DEF(__BYTDIS,0)
DEF(__ROMEN,0)
DEF(__RDYEN0,0)
DEF(__SGTDIS,0)



DEF(SYSCON23)
DEF(__PDCON,0)

DEF(__CLKREL,01fh)
DEF(__ADCDIS,0)
DEF(__ASC0DIS,0)
DEF(__SSCDIS,0)
DEF(__GPTDIS,0)

DEF(__CC1DIS,0)
DEF(__CC2DIS,0)
DEF(__PWMDIS,0)

DEF(__CAN1DIS,0)
DEF(__CAN2DIS,0)
DEF(__PCDDIS,0)
DEF(__DFMDIS,0)
DEF(__PFMDIS,0)




DEF(__MCTC,1)

DEF(__RWDC0,0)
DEF(__MTTC,0)

DEF(__EWEN0,0)
DEF(__ALECTL0,0)
DEF(__BUSACT0,1)
DEF(__BSWC0,0)
DEF(__RDYEN0,0)

DEF(__CSREN0,0)
DEF(__CSWEN0,0)

DEF(__ADCDIS,0)




















DEF(__BUSACT1,0)













DEF(__BUSACT2,0)













DEF(__BUSACT3,0)













DEF(__BUSACT4,0)







DEF(XPERCON)
DEF(__XPER0,1)
DEF(__XPER1,1)












DEF(__XPER11,0)





DEF(__XPER14,0)







DEF(__WDTPRE,0)


DEF(SYSCON1)
DEF(__SLEEPCON,0)









































DEF(EVA,1)
DEF(EX_AB,0)
DEF(BIT_INIT,0)


DEF(MODEL,SMALL)
DEF(_USRSTACK,0)
DEF(_SINGLE_FP,0)
